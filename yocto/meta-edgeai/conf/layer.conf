## yocto/meta-edgeai/conf/layer.conf
```bitbake
BBPATH .= ":${LAYERDIR}"
BBFILES += "${LAYERDIR}/recipes-*/*/*.bb ${LAYERDIR}/recipes-*/*/*.bbappend"
BBFILE_COLLECTIONS += "edgeai"
BBFILE_PATTERN_edgeai = "^${LAYERDIR}/"
BBFILE_PRIORITY_edgeai = "10"
LAYERDEPENDS_edgeai = "core raspberrypi openembedded-layer meta-python"
LAYERSERIES_COMPAT_edgeai = "wrynose"
```
